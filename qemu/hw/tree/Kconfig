## qemu/hw/tree/Kconfig
```kconfig
config RISCV_NUMA
    bool

config RISCV_VIRT
    bool
    imply PCI_DEVICES
    imply VIRTIO_VGA
    imply TEST_DEVICES
    select RISCV_NUMA
    select GOLDFISH_RTC
    select MSI_NONBROKEN
    select PCI
    select PCI_EXPRESS_GENERIC_BRIDGE
    select PFLASH_CFI01
    select SERIAL
    select SIFIVE_CLINT
    select SIFIVE_PLIC
    select SIFIVE_TEST
    select VIRTIO_MMIO
    select FW_CFG_DMA
```
